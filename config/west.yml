## config/west.yml
```yaml
manifest:
  remotes:
    - name: zmkfirmware
      url-base: https://github.com/zmkfirmware
    - name: gpeye
      url-base: https://github.com/GPeye
    - name: tokyo2006
      url-base: https://github.com/tokyo2006
    - name: englmaxi
      url-base: https://github.com/englmaxi
  projects:
    - name: mario-peripheral-animation
      remote: gpeye
      revision: 1aa3950 
    - name: zmk
      remote: zmkfirmware
      revision: 5138c6f
      import: app/west.yml
    - name: prospector-zmk-module                 # <--- and these
      remote: tokyo2006                          # <---
      revision: micro_spi2  
    - name: zmk-dongle-display
      remote: englmaxi
      revision: 4a76cc7
  self:
    path: config
```
